macro_notionlinkcopy: macro_notionlinkcopy{
compatible = "zmk,behavior-macro";
label = "macro_notionlinkcopy";
#binding-cells = <0>;
bindings = <&kp RIGHT_COMMAND>, <&kp RIGHT_ALT>, <&kp L>;
};
macro_brackets: macro_brackets{
compatible = "zmk,behavior-macro";
label = "macro_brackets";
#binding-cells = <0>;
bindings = <&kp LBKT>, <&kp RBKT>, <&kp SPACE>;
};